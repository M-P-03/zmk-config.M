## boards/shields/swoopy/Kconfig.defconfig
```kconfig
# Copyright (c) 2020 The ZMK Contributors
# SPDX-License-Identifier: MIT

if SHIELD_SWOOPY_LEFT

config ZMK_KEYBOARD_NAME
    default "Swoopy"

config ZMK_SPLIT_ROLE_CENTRAL
    default y

endif

if SHIELD_SWOOPY_LEFT || SHIELD_SWOOPY_RIGHT

config ZMK_SPLIT
    default y

endif
```

## boards/shields/swoopy/Kconfig.shield
```kconfig
# Copyright (c) 2020 The ZMK Contributors
# SPDX-License-Identifier: MIT

config SHIELD_SWOOPY_LEFT
    def_bool $(shields_list_contains,swoopy_left)

config SHIELD_SWOOPY_RIGHT
    def_bool $(shields_list_contains,swoopy_right)
```
